## arch/arm/boot/kernel_fdt.its
```
/dts-v1/;

/ {
	description = "Simple image with single Linux kernel and FDT blob";
	#address-cells = <1>;

	images {
		kernel@1 {
			description = "AC8317 Linux kernel";
			data = /incbin/("./zImage");
			type = "kernel";
			arch = "arm";
			os = "linux";
			compression = "none";
			load = <0x01008000>;
			entry = <0x01008000>;
		};
		fdt@1 {
			description = "Flattened Device Tree blob";
			data = /incbin/("./ac83xx.dtb");
			type = "flat_dt";
			arch = "arm";
			compression = "none";
		};
	};

	configurations {
		default = "conf@1";
		conf@1 {
			description = "Boot Linux kernel with FDT blob";
			kernel = "kernel@1";
			fdt = "fdt@1";
		};
	};
};
```

## arch/arm/mach-ac83xx/Kconfig
```kconfig
if ARCH_AC83XX

menu "Autochips AC83XX System-on-Chip"

comment "AC83XX Board Type"

config MACH_AC83XXFPGA
    bool "AC83XX FPGA"
	depends on ARCH_AC83XX
	help
	  select this if you are using V6x2 FPGA board

config MACH_AC83XX
    bool "AC83XX RealChip"
	depends on ARCH_AC83XX
	help
	  select this if you are using AC83XX EVB board

endmenu

config MTK_WIN32_SUPPORT
	int 	
	depends on ARCH_AC83XX
	default 1

config HZ
	int
	depends on ARCH_AC83XX
	default 1000
	
config DVP_RESERVED_MEM
	bool
	default y

endif
```

## arch/arm/mach-mt33xx/Kconfig
```kconfig
if ARCH_MT33XX

menu "MediaTek MT33xx System-on-Chip"

choice
	prompt "MediaTek MT33xx Processor"

config ARCH_MT8520
	bool "MT8520"

config ARCH_MT8530
	bool "MT8530"

config ARCH_MT8550
	bool "MT8550"

config ARCH_MT8555
	bool "MT8555"

config ARCH_MT8560
	bool "MT8560"

config ARCH_MT8580
	bool "MT8580"

config ARCH_MT3360
	bool "MT3360"

endchoice

endmenu

config MTK_WIN32_SUPPORT
	int 	
	depends on ARCH_MT33XX
	default 1

config HZ
	int
	depends on ARCH_MT33XX
	default 1000
	
config DVP_RESERVED_MEM
	bool
	default y

endif
```
